## prj.conf
```kconfig
CONFIG_NET_TC_THREAD_PREEMPTIVE=y

# Generic networking options
CONFIG_NETWORKING=y
CONFIG_NET_UDP=y
CONFIG_NET_TCP=y
CONFIG_NET_IPV6=y
CONFIG_NET_IPV4=y
CONFIG_NET_SOCKETS=y
CONFIG_NET_SOCKETS_POSIX_NAMES=y
CONFIG_NET_SOCKETS_POLL_MAX=4
CONFIG_NET_CONNECTION_MANAGER=y

# Kernel options
CONFIG_ENTROPY_GENERATOR=y
CONFIG_TEST_RANDOM_GENERATOR=y
CONFIG_INIT_STACKS=y

# Logging
CONFIG_NET_LOG=y
CONFIG_LOG=y
CONFIG_NET_STATISTICS=n
CONFIG_PRINTK=y

# Network buffers
CONFIG_NET_PKT_RX_COUNT=16
CONFIG_NET_PKT_TX_COUNT=16
CONFIG_NET_BUF_RX_COUNT=80
CONFIG_NET_BUF_TX_COUNT=80
CONFIG_NET_CONTEXT_NET_PKT_POOL=n

# IP address options
CONFIG_NET_IF_UNICAST_IPV6_ADDR_COUNT=6
CONFIG_NET_IF_MCAST_IPV6_ADDR_COUNT=8
CONFIG_NET_MAX_CONTEXTS=10

# Network shell
CONFIG_NET_SHELL=y

# The addresses are selected so that qemu<->qemu connectivity works ok.
# For linux<->qemu connectivity, create a new conf file and swap the
# addresses (so that peer address is ending to 2).
CONFIG_NET_CONFIG_SETTINGS=n
CONFIG_NET_CONFIG_NEED_IPV6=y
#CONFIG_NET_CONFIG_MY_IPV6_ADDR="2001:db8::2"
#CONFIG_NET_CONFIG_PEER_IPV6_ADDR="2001:0db8:0001:ffff:0000:0000:ac11:0001"
CONFIG_NET_CONFIG_NEED_IPV4=y
#CONFIG_NET_CONFIG_MY_IPV4_ADDR="192.0.2.2"
#CONFIG_NET_CONFIG_PEER_IPV4_ADDR="192.0.2.1"

# Accelerometer options
CONFIG_STDOUT_CONSOLE=y
CONFIG_I2C=y
CONFIG_SENSOR=y
CONFIG_LIS2DH=y
CONFIG_CBPRINTF_FP_SUPPORT=y
CONFIG_LIS2DH_TRIGGER_GLOBAL_THREAD=n
CONFIG_LIS2DH_OPER_MODE_HIGH_RES=n
CONFIG_LIS2DH_OPER_MODE_LOW_POWER=n
CONFIG_LIS2DH_ODR_2=n
```

## src/common.h
```c
/*
 * Copyright (c) 2017 Intel Corporation.
 * Copyright (c) 2018 Nordic Semiconductor ASA.
 *
 * SPDX-License-Identifier: Apache-2.0
 */

/* Value of 0 will cause the IP stack to select next free port */
#define MY_PORT 0

#define PEER_PORT 4242

#if IS_ENABLED(CONFIG_NET_TC_THREAD_PREEMPTIVE)
#define THREAD_PRIORITY K_PRIO_PREEMPT(8)
#else
#define THREAD_PRIORITY K_PRIO_COOP(CONFIG_NUM_COOP_PRIORITIES - 1)
#endif

#define UDP_TRANSMISSION_PERIOD_MSEC		60000
#define UDP_TRANSMISSION_PERIOD_TAG_MSEC	1000
#define UDP_TRANSMISSION_BYTES			40

#define UID_CHARS 		12
#define SESSION_RAND_CHARS 	4

struct data {
	const char *proto;

	struct {
		int sock;
		uint32_t transmitting;
		uint32_t mtu;
	} udp;
};

struct configs {
	struct data ipv6;
};

#if !defined(CONFIG_NET_CONFIG_PEER_IPV6_ADDR)
#define CONFIG_NET_CONFIG_PEER_IPV6_ADDR "2001:0db8:0001:ffff:0000:0000:ac11:0001"
#endif

extern int32_t lorem_ipsum[];
extern const int ipsum_len;
extern struct configs conf;

int start_udp(void);
void stop_udp(void);
int send_udp_data(struct data *data);
```

## src/socket-test.c
```c
/* socket-test.c - Networking UDP socket client */

/*
 * Copyright (c) 2022 RedNodeLabs UG.
 *
 * SPDX-License-Identifier: Apache-2.0
 */

/*
 * The socket-test application is acting as a client that is run in Zephyr OS,
 * and the server is run in the host acting as a server.
 */

#include <logging/log.h>
LOG_MODULE_REGISTER(net_socket_test_sample, LOG_LEVEL_DBG);

#include <zephyr.h>
#include <errno.h>
#include <stdio.h>

#include <syscalls/rand32.h>
#include <net/socket.h>
#include <net/net_mgmt.h>
#include <net/net_event.h>
#include <net/net_conn_mgr.h>
#include <net/ieee802154_radio.h>

#include <device.h>
#include <drivers/sensor.h>

#if defined(CONFIG_REDNODEBUS)
#include "rnb_utils.h"
#endif

#include "common.h"

#define INVALID_SOCK (-1)

#define EVENT_MASK (NET_EVENT_L4_CONNECTED | \
		    NET_EVENT_L4_DISCONNECTED)

#define MTU_SIZE 1280

static uint8_t rnb_role;

void rnb_utils_handle_new_state(const struct rednodebus_user_event_state *event_state)
{
	rnb_role = event_state->role;
}

int32_t lorem_ipsum[10];
const int ipsum_len = sizeof(lorem_ipsum);

const struct device *sensor;

struct configs conf = {
	.ipv6 = {
		.proto = "IPv6",
		.udp.sock = INVALID_SOCK
	},
};

static void init_app(void)
{
	conf.ipv6.udp.mtu = MTU_SIZE;

#if defined(CONFIG_REDNODEBUS)
	uint64_t euid = 0;
	rnb_utils_get_euid(&euid);

	lorem_ipsum[0] = (uint32_t)euid;
	lorem_ipsum[1] = (uint32_t)(euid >> 32);

	int session_rand = sys_rand32_get();
	lorem_ipsum[2] = session_rand;
#endif
}

static void fetch_and_display(const struct device *sensor)
{
	static unsigned int count;
	struct sensor_value accel[3];
	const char *overrun = "";
	int rc = sensor_sample_fetch(sensor);

	++count;
	if (rc == -EBADMSG) {
		/* Sample overrun.  Ignore in polled mode. */
		if (IS_ENABLED(CONFIG_LIS2DH_TRIGGER)) {
			overrun = "[OVERRUN] ";
		}
		rc = 0;
	}
	if (rc == 0) {
		rc = sensor_channel_get(sensor,
					SENSOR_CHAN_ACCEL_XYZ,
					accel);
	}
	// Data accelerometer to lorem_ipsum
	lorem_ipsum[4] = accel[0].val1;
	lorem_ipsum[5] = accel[0].val2;
	lorem_ipsum[6] = accel[1].val1;
	lorem_ipsum[7] = accel[1].val2;
	lorem_ipsum[8] = accel[2].val1;
	lorem_ipsum[9] = accel[2].val2;
	send_udp_data(&conf.ipv6);

	if (rc < 0) {
		LOG_INF("ERROR: Update failed: %d\n", rc);
	} else {
		LOG_INF("#%u EUID 0x%04X%04X @ %u ms: %sx: %06d.%06d  , y: %06d.%06d , z: %06d.%06d\n",
			   count, lorem_ipsum[0], lorem_ipsum[1], k_uptime_get_32(), overrun,
			   lorem_ipsum[4],lorem_ipsum[5],
			   lorem_ipsum[6],lorem_ipsum[7],
			   lorem_ipsum[8],lorem_ipsum[9]);
	}
}

#ifdef CONFIG_LIS2DH_TRIGGER
static void trigger_handler(const struct device *dev,
			    const struct sensor_trigger *trig)
{
	fetch_and_display(dev);
}
#endif

static void accelerometer(){

	sensor = DEVICE_DT_GET_ANY(st_lis2dh);

	if (sensor == NULL) {
		LOG_INF("No device found\n");
		return;
	}
	if (!device_is_ready(sensor)) {
		LOG_INF("Device %s is not ready\n", sensor->name);
		return;
	}

#if CONFIG_LIS2DH_TRIGGER
	{
		struct sensor_trigger trig;
		int rc;

		trig.type = SENSOR_TRIG_DATA_READY;
		trig.chan = SENSOR_CHAN_ACCEL_XYZ;

		if (IS_ENABLED(CONFIG_LIS2DH_ODR_RUNTIME)) {
			struct sensor_value odr = {
				.val1 = 1,
			};

			rc = sensor_attr_set(sensor, trig.chan,
					     SENSOR_ATTR_SAMPLING_FREQUENCY,
					     &odr);
			if (rc != 0) {
				LOG_INF("Failed to set odr: %d\n", rc);
				return;
			}
			LOG_INF("Sampling at %u Hz\n", odr.val1);
		}

		rc = sensor_trigger_set(sensor, &trig, trigger_handler);
		if (rc != 0) {
			LOG_INF("Failed to set trigger: %d\n", rc);
			return;
		}

		LOG_INF("Waiting for triggers\n");
	}
#endif /* CONFIG_LIS2DH_TRIGGER */

}

static int start_client(void)
{
	int iterations = CONFIG_NET_SAMPLE_SEND_ITERATIONS;
	int i = 0;
	int ret;

	while (iterations == 0 || i < iterations) {
		ret = start_udp();

		if (rnb_role == REDNODEBUS_USER_ROLE_TAG){
			accelerometer();
			while (ret == 0) {

				if (!IS_ENABLED(CONFIG_LIS2DH_TRIGGER_GLOBAL_THREAD)) {
					//If trigger not set, Polling at 0.5 Hz
					fetch_and_display(sensor);
				}
				k_sleep(K_MSEC(2000));

				if (iterations > 0) {
					i++;
					if (i >= iterations) {
						break;
					}
				}
			}
		}
		stop_udp();
	}
	return ret;
}


void main(void)
{
#if defined(CONFIG_REDNODEBUS)
	init_rnb();

	while (!is_rnb_connected())
	{
		k_sleep(K_MSEC(1000));
	}

	k_sleep(K_MSEC(1000));
#endif

	init_app();

	k_thread_priority_set(k_current_get(), THREAD_PRIORITY);

	exit(start_client());
}
```

## src/udp.c
```c
/* udp.c - UDP specific code for echo client */

/*
 * Copyright (c) 2017 Intel Corporation.
 * Copyright (c) 2018 Nordic Semiconductor ASA.
 *
 * SPDX-License-Identifier: Apache-2.0
 */

#include <logging/log.h>
LOG_MODULE_DECLARE(net_socket_test_sample, LOG_LEVEL_DBG);

#include <zephyr.h>
#include <errno.h>
#include <stdio.h>

#include <net/socket.h>
#include <net/tls_credentials.h>
#include <random/rand32.h>

#include "common.h"

int send_udp_data(struct data *data)
{
	int ret;
	static int packets_sent;


	lorem_ipsum[3] = packets_sent;

	do {
		//data->udp.transmitting = sys_rand32_get() % ipsum_len;
		data->udp.transmitting = ipsum_len;
	} while (data->udp.transmitting == 0U ||
		 data->udp.transmitting > data->udp.mtu);

	ret = send(data->udp.sock, lorem_ipsum, data->udp.transmitting, 0);

	LOG_DBG("%s UDP: Sent %d bytes", data->proto, data->udp.transmitting);

	packets_sent ++;

	return ret < 0 ? -EIO : 0;
}

static int start_udp_proto(struct data *data, struct sockaddr *addr,
			   socklen_t addrlen)
{
	int ret;

	data->udp.sock = socket(addr->sa_family, SOCK_DGRAM, IPPROTO_UDP);

	if (data->udp.sock < 0) {
		LOG_ERR("Failed to create UDP socket (%s): %d", data->proto,
			errno);
		return -errno;
	}

	/* Call connect so we can use send and recv. */
	ret = connect(data->udp.sock, addr, addrlen);
	if (ret < 0) {
		LOG_ERR("Cannot connect to UDP remote (%s): %d", data->proto,
			errno);
		ret = -errno;
	}

	return ret;
}

int start_udp(void)
{
	int ret = 0;
	struct sockaddr_in6 addr6;

	if (IS_ENABLED(CONFIG_NET_IPV6)) {
		addr6.sin6_family = AF_INET6;
		addr6.sin6_port = htons(PEER_PORT);
		inet_pton(AF_INET6, CONFIG_NET_CONFIG_PEER_IPV6_ADDR,
			  &addr6.sin6_addr);

		ret = start_udp_proto(&conf.ipv6, (struct sockaddr *)&addr6,
				      sizeof(addr6));
		if (ret < 0) {
			return ret;
		}
	}

	return ret;
}

void stop_udp(void)
{
	if (IS_ENABLED(CONFIG_NET_IPV6)) {
		if (conf.ipv6.udp.sock >= 0) {
			(void)close(conf.ipv6.udp.sock);
		}
	}
}
```
